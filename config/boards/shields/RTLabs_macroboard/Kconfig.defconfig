## config/boards/shields/RTLabs_macroboard/Kconfig.defconfig
```kconfig
if SHIELD_RTLABS_MACROBOARD

config ZMK_KEYBOARD_NAME
    default "RTLabs Pad"

endif
```

## config/boards/shields/RTLabs_macroboard/Kconfig.shield
```kconfig
config SHIELD_RTLABS_MACROBOARD
    def_bool $(shields_list_contains,RTLabs_macroboard)
```

## config/boards/shields/RTLabs_macropad/Kconfig.defconfig
```kconfig
if SHIELD_RTLABS_MACROPAD

config ZMK_KEYBOARD_NAME
    default "RTLabs Macropad"

endif
```

## config/boards/shields/RTLabs_macropad/Kconfig.shield
```kconfig
config SHIELD_RTLABS_MACROPAD
    def_bool $(shields_list_contains,RTLabs_macropad)
```
